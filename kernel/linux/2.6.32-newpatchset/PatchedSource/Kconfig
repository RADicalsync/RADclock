## kernel/linux/2.6.32-newpatchset/PatchedSource/Kconfig
```kconfig
#
# FFClock device driver configuration
#

menu "Feed Forward Clock Module"

config FFCLOCK_MODULE
	boolean "Kernel support for the Feed Forward Clock"
	depends on EXPERIMENTAL && GENERIC_TIME && FFCLOCK
	default y
	help
          Defines support and access to a consistent virtual counter, the basis
          of the FFClock (a feed-forward synchronization algorithm) and
          corresponding applications.
endmenu
```

## kernel/linux/4.19.0/CurrentSource/Kconfig
```kconfig
#
# FFclock device driver configuration
#

menu "FFclock Driver"

#
# Would be nice to go back to having this as a module
#
config FFCLOCK
	bool "Kernel support for the FFclock"
#	depends on EXPERIMENTAL && GENERIC_TIME
	default y
	help
	  Defines support and access to a consistent virtual counter, the basis
	  of the FFclock (a feed-forward synchronization algorithm) and corresponding
	  applications.

endmenu
```
